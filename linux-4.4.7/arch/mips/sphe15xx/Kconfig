## linux-4.4.7/arch/mips/sphe15xx/Kconfig
```kconfig
if SPHE15XX

config SPHE1512
	bool

config SPHE1506
	bool

choice
	prompt "Sunplus SoC family selection"
	default SUNPLUS_SPHE1512
	depends on SPHE15XX
	help
	  Select SPHE15XX MIPS SoC implementation.

	config SUNPLUS_SPHE1512
		bool "Sunplus SPHE1512 dvbs2 hd soc ddr1"
		select SPHE1512

	config SUNPLUS_SPHE1506
		bool "Sunplus SPHE1506 dvbs2 hd soc ddr2"
		select SPHE1506

endchoice

endif
```

## linux-4.4.7/drivers/net/ethernet/sunplus/Kconfig
```kconfig
#
# Sunplus device configuration
#

config NET_VENDOR_SUNPLUS
	bool "Sunplus devices"
	default y

	depends on SPHE15XX
	---help---
	  If you have a network (Ethernet) card belonging to this
	  class, say Y here.

	  Note that the answer to this question doesn't directly
	  affect the kernel: saying N will just cause the configurator
	  to skip all the questions about sunplus cards. If you say Y,
	  you will be asked for your specific card in the following
	  questions.

if NET_VENDOR_SUNPLUS

config SPHE15XX_EMAC
        tristate "Sunplus SPHE15XX EMAC support"
	depends on SPHE15XX
	depends on OF
	select CRC32
	select MII
	select PHYLIB
	select MDIO_SPHE15XX
        ---help---
          Support for Sunplus SPHE15XX EMAC ethernet driver.

          To compile this driver as a module, choose M here.  The module
          will be called sphe15xx-emac.

endif # NET_VENDOR_SUNPLUS
```
